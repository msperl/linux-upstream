## Documentation/devicetree/bindings/clock/brcm,bcm2835-aux-clock.txt
```
Broadcom BCM2835 auxiliary peripheral clocks

This binding uses the common clock binding:
    Documentation/devicetree/bindings/clock/clock-bindings.txt

This controls the clock gating for the BCM2835 auxiliary peripherals
(UART, SPI1, and SPI2).

Required properties:
- compatible:	Should be "brcm,bcm2835-aux-clock"
- #clock-cells:	Should be <1>. The permitted clock-specifier values can be
		  found in include/dt-bindings/clock/bcm2835-aux.h
- reg:		Specifies base physical address and size of the gate register
- clocks:	The parent clock phandle

Example:

	clocks: cprman@7e101000 {
		compatible = "brcm,bcm2835-cprman";
		#clock-cells = <1>;
		reg = <0x7e101000 0x2000>;
		clocks = <&clk_osc>;
	};

	aux_clocks: aux-clocks@0x7e215004 {
		compatible = "brcm,bcm2835-aux-clock";
		#clock-cells = <1>;
		reg = 0x7e215004 0x4>;
		clocks = <&clk_osc>;
		clocks = <&clocks BCM2835_CLOCK_VPU>;
	};
```

## Documentation/devicetree/bindings/clock/brcm,bcm2835-cprman.txt
```
Broadcom BCM2835 CPRMAN clocks

This binding uses the common clock binding:
    Documentation/devicetree/bindings/clock/clock-bindings.txt

The CPRMAN clock controller generates clocks in the audio power domain
of the BCM2835.  There is a level of PLLs deriving from an external
oscillator, a level of PLL dividers that produce channels off of the
few PLLs, and a level of mostly-generic clock generators sourcing from
the PLL channels.  Most other hardware components source from the
clock generators, but a few (like the ARM or HDMI) will source from
the PLL dividers directly.

Required properties:
- compatible:	Should be "brcm,bcm2835-cprman"
- #clock-cells:	Should be <1>. The permitted clock-specifier values can be
		  found in include/dt-bindings/clock/bcm2835.h
- reg:		Specifies base physical address and size of the registers
- clocks:	The external oscillator clock phandle
- #address-cells number of cells required to define a clock
- #size-cells    Should be 0

Subnodes:

It is possible to apply optional settings per clock to modify clock
selection behaviour.
For each clock there may be a subnode that may contain the following:

Required properties:
- reg                 -  clock id

Optional properties:
- parent-clock-names  - list of parrent-clock names
  		        this list is validated againt the default list
		        of parent clocks and is used in this order.
- brcm,clock-selector - the clock selector to use
- brcm,mash-max-order - the maximum order of the fractional divider
- brcm,min-fract-div  - the minimum divider required when using
  		      	the fractional divider

Example:

	clk_osc: clock@3 {
		compatible = "fixed-clock";
		reg = <3>;
		#clock-cells = <0>;
		clock-output-names = "osc";
		clock-frequency = <19200000>;
	};

	clocks: cprman@7e101000 {
		compatible = "brcm,bcm2835-cprman";
		#clock-cells = <1>;
		reg = <0x7e101000 0x2000>;
		clocks = <&clk_osc>;

		#address-cells = <1>;
		#size-cells = <0>;

		/* custom settings for the PCM clock */
		clock@BCM2835_CLOCK_PCM {
			 reg = <BCM2835_CLOCK_PCM>;
			 parent-clock-names = "xosc", "plld_per";
			 brcm,clock-selector =
				  <BCM2835_CHOOSE_CLOCK_INTEGER_THEN_FRAC>;
			 brcm,mash-max-order = <BCM2835_MASH_ORDER_3>;
			 brcm,min-fract-div = <20>;
		};
	};

	i2c0: i2c@7e205000 {
		compatible = "brcm,bcm2835-i2c";
		reg = <0x7e205000 0x1000>;
		interrupts = <2 21>;
		clocks = <&clocks BCM2835_CLOCK_VPU>;
		#address-cells = <1>;
		#size-cells = <0>;
	};
```

## Documentation/devicetree/bindings/memory-controllers/brcm,bcm2835-sdram.txt
```
Binding for SDRAM driver for BCM2835 SoCs.

Required parameters:
-------------------

compatible : 	should be: "brcm,bcm2835-sdram"
reg :		Address range of the SD register-set.
clocks : 	Phandle of the clock used by the sdram.

Example:

memory-conroller@7ee00000 {
	compatible = "brcm,bcm2835-sdram";
	reg = <0x7ee00000 0x18c>;
	clocks = <&clocks BCM2835_CLOCK_SDRAM>;
};
```

## Documentation/devicetree/bindings/sound/hifiberry,hifiberry-dac.txt
```
* Hifiberry-dac soundcard-hat for raspberry-pi

Required properties:
- compatible: "hifiberry,hifiberry-dac"
- i2s-controller: phandle of the bcm2835 i2s controller

Example:

sound {
      compatible = "hifiberry,hifiberry-dac";
      i2s-controller = <&i2s>;
};
```

## Documentation/devicetree/bindings/spi/brcm,bcm2835-aux-spi.txt
```
Broadcom BCM2835 auxiliar SPI1/2 controller

The BCM2835 contains two forms of SPI master controller, one known simply as
SPI0, and the other known as the "Universal SPI Master"; part of the
auxiliary block. This binding applies to the SPI1/2 controller.

Required properties:
- compatible: Should be "brcm,bcm2835-aux-spi".
- reg: Should contain register location and length for the spi block
- interrupts: Should contain shared interrupt of the aux block
- clocks: The clock feeding the SPI controller.
- cs-gpios: the cs-gpios (native cs is NOT supported)
	    see also spi-bus.txt
- bcrm,aux-enable: the bcrm,bcm2835-aux-enable config entry to handle
		  enabling/disabling of the spi1/spi2/uart1 HW block
		  second "argument" is the mask to apply to the
		  enable register

Example:

spi1@7e215080 {
	compatible = "brcm,bcm2835-aux-spi";
	reg = <0x7e215080 0x40>;
	interrupts = <1 29>;
	clocks = <&clk_spi>;
	#address-cells = <1>;
	#size-cells = <0>;
	cs-gpios = <&gpio 18>, <&gpio 17>, <&gpio 16>;
	bcrm,aux-enable = <&aux_enable 2>;
};

spi2@7e2150c0 {
	compatible = "brcm,bcm2835-aux-spi";
	reg = <0x7e2150c0 0x40>;
	interrupts = <1 29>;
	clocks = <&clk_spi>;
	#address-cells = <1>;
	#size-cells = <0>;
	cs-gpios = <&gpio 43>, <&gpio 44>, <&gpio 45>;
	bcrm,aux-enable = <&aux_enable 4>;
};

/* the necessary bcm2835 aux-enable referenced above */
aux_enable: aux_enable@0x7e215004 {
	compatible = "bcrm,bcm2835-aux";
	reg = <0x7e215004 0x04>;
};
```

## drivers/net/can/spi/Kconfig
```kconfig
menu "CAN SPI interfaces"
	depends on SPI

config CAN_HI311X
	tristate "Holt HI311x SPI CAN controllers"
	depends on CAN_DEV && SPI && HAS_DMA
	---help---
	  Driver for the Holt HI311x SPI CAN controllers.

config CAN_MCP251X
	tristate "Microchip MCP251x SPI CAN controllers"
	depends on HAS_DMA
	---help---
	  Driver for the Microchip MCP251x SPI CAN controllers.

config CAN_MCP2517FD
	tristate "Microchip MCP2517FD SPI CAN controllers"
	depends on HAS_DMA
	---help---
	  Driver for the Microchip MCP2517FD SPI CAN controllers.

endmenu
```

## drivers/thermal/bcm/Kconfig
```kconfig
config BCM2835_THERMAL
       tristate "Thermal sensors on bcm2835 SoC"
       help
         Support for thermal sensors on Broadcom bcm2835 SoCs.
```
